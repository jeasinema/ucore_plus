## ucore/src/kern-ucore/Kconfig
```kconfig
menu "Platform setup"

choice
    prompt "Supported platforms"
config ARCH_AMD64
    bool "x86_64 Architecture"
    default n

config ARCH_ARM
    bool "ARM Architecture"
    default y

config ARCH_I386
    bool "x86_32 Architecture"
    default n

config ARCH_MIPS
    bool "MIPS Architecture"
    default n

config ARCH_NIOSII
    bool "Altera NIOSII Architecture"
    default n

config ARCH_OR32
    bool "OpenRISC32 Architecture"
    default n

config ARCH_USER_MODE
    bool "User Mode uCore"
    default n

endchoice

endmenu

menu "Toolchain setup"

config CROSS_COMPILE
  string "Cross-compiler tool prefix"

config ADDITIONAL_CFLAGS
  string "Additional CFLAGS"

config ADDITIONAL_LDFLAGS
  string "Additional LDFLAGS"

config BIONIC_LIBC
  bool "Enable bionic C library related-code"
  default n
  help
    When selected, this option enable bionic C related code. Note that currently
    only amd64 and ARM architecture is supported. Enabling this on other
    architectures triggers compiling error.

endmenu
```

## ucore/src/kern-ucore/arch/amd64/Kconfig
```kconfig
source src/kern-ucore/Kconfig
source src/kern-ucore/numa/Kconfig
source src/kern-ucore/mm/Kconfig
source src/kern-ucore/schedule/Kconfig
source src/kern-ucore/fs/Kconfig
source src/kern-ucore/dde36/Kconfig

menu "Profiler"
config PROFILER_ON
    depends ARCH_AMD64
	bool "Enable profiler"
	default n

endmenu
```
